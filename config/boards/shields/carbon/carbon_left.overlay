#include "carbon.dtsi" // Notice that the main dtsi files are included in the overlay.

&kscan0 {
row-gpios
        = <&xiao_d 5 (GPIO_ACTIVE_HIGH | GPIO_PULL_DOWN)> // Row A from the schematic file
        , <&xiao_d 1 (GPIO_ACTIVE_HIGH | GPIO_PULL_DOWN)> // Row B from the schematic file
        , <&gpio0 10 (GPIO_ACTIVE_HIGH | GPIO_PULL_DOWN)> // Row C from the schematic file
        , <&gpio0 9 (GPIO_ACTIVE_HIGH | GPIO_PULL_DOWN)> // Row D from the schematic file
        , <&xiao_d 0 (GPIO_ACTIVE_HIGH | GPIO_PULL_DOWN)> // Row E from the schematic file
        ;

col-gpios
        = <&xiao_d 10 GPIO_ACTIVE_HIGH> // col1 in the schematic
        , <&xiao_d 9 GPIO_ACTIVE_HIGH> // col2 in the schematic
        , <&xiao_d 7 GPIO_ACTIVE_HIGH> // col3 in the schematic
        , <&xiao_d 6 GPIO_ACTIVE_HIGH> // col4 in the schematic
        , <&xiao_d 3 GPIO_ACTIVE_HIGH> // col5 in the schematic
        , <&xiao_d 2 GPIO_ACTIVE_HIGH> // col6 in the schematic
        , <&xiao_d 4 GPIO_ACTIVE_HIGH> // col6 in the schematic
        ;
};