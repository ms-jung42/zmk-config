## config/boards/shields/carbon/Kconfig.defconfig
```kconfig
if SHIELD_CARBON_LEFT
config ZMK_KEYBOARD_NAME
    default "carbon"
config ZMK_SPLIT_ROLE_CENTRAL
    default y
endif

if SHIELD_CARBON_LEFT || SHIELD_CARBON_RIGHT
config ZMK_SPLIT
    default y
endif
```

## config/boards/shields/carbon/Kconfig.shield
```kconfig
config SHIELD_CARBON_LEFT
    def_bool $(shields_list_contains, carbon_left)
config SHIELD_CARBON_RIGHT
    def_bool $(shields_list_contains, carbon_left)
```
